## conf/distro/hidist.conf
```bitbake
GCCVERSION = "6.%"

#OLDEST_KERNEL = "2.6.32"
#SDK_OLDEST_KERNEL = "2.6.32"

#PREFERRED_PROVIDER_virtual/kernel = "linux-yocto"
#PREFERRED_VERSION_linux-yocto = "3.0.8"

TCMODE ?= "default"
#TCLIBC ?= "uclibc"
TCLIBC ?= "musl"

# Allow single libc distros to disable this code
TCLIBCAPPEND ?= "-${TCLIBC}"
TMPDIR .= "${TCLIBCAPPEND}"

CACHE = "${TMPDIR}/cache/${TCMODE}-${TCLIBC}${@['', '/' + str(d.getVar('MACHINE'))][bool(d.getVar('MACHINE'))]}${@['', '/' + str(d.getVar('SDKMACHINE'))][bool(d.getVar('SDKMACHINE'))]}"

USER_CLASSES ?= ""
PACKAGE_CLASSES ?= "package_ipk"
INHERIT_BLACKLIST = "blacklist"
INHERIT_DISTRO ?= "debian devshell sstate license remove-libtool"
INHERIT += "${PACKAGE_CLASSES} ${USER_CLASSES} ${INHERIT_DISTRO} ${INHERIT_BLACKLIST}"

DISTRO_FEATURES_remove = " 3g bluetooth irda x11 wayland bluez5"
```
